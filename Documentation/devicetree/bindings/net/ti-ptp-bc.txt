## Documentation/devicetree/bindings/net/ti-ptp-bc.txt
```
Texas Instruments PTP Boundary Clcok Internal Sync Monitor
==========================================================

Required properties:
- compatible       : Should be
                        "ti,am57-bc" for AM57xx SoCs

Example:
========

In am57xx-idk-common.dts
	ptp_bc: ptp_bc {
		compatible = "ti,am57-bc";
		status = "disabled";
	};

To enable for am572x-idk, in am572x-idk.dts:

&ptp_bc {
	status = "okay";
};
```

## Documentation/devicetree/bindings/soc/ti/keystone-crypto.txt
```
Keystone Crypto Driver

This document explains the device tree bindings for the side-band Security
Accelerator on keystone devices.

Required properties:
 - compatible: should be "ti,netcp-sa-crypto".

 - clock: phandle to clksa clock.

 - clock-names: functional clock name. Should be set to "fck".

 - syscon-subsys: phandle to sa_config node, which represent registers common,
        for SA and HWRNG modules.

 - ti,navigator-dmas and ti,navigator-dma-names: Security accelerator uses
	2 dma channels. Rx and Tx. The first property is the pandle to the
	knav_dmas subsystem and flow for RX channel and channel number for
	TX channel. The second property is corresponding channel names.

 - ti,rx-channel: name of RX channel.

 - ti,rx-queue-depth: RX channel may use upto 4 free descriptor queue.
	rx-queue-depth describes number of buffers in each queue.

 - ti,rx-compl-queue: RX completion queue number.

 - ti,rx-pool: number of buffer descriptos and region for rx-pool.

 - ti,tx-channel: name of TX channel.

 - ti,tx-queue-depth: number of TX descriptos.

 - ti,tx-completion-queue: TX completion queue number.

 - ti,tx-pool: number of buffer descriptos and region for tx-pool.

 - ti,tx-submit-queue: submition queue number for TX channel.

 - ti,sc-id: range of security contex IDs available for driver


Example for K2HK:

sa_subsys: subsys@20c0000 {
	#address-cells = <1>;
	#size-cells = <1>;
	ranges = <0 0x20c0000 0x40000>;
	compatible = "simple-bus";

	sa_config: subsys {
		compatible = "syscon";
		reg = <0x0 0x100>;
	};

	crypto {
		compatible = "ti,netcp-sa-crypto";
		syscon-subsys = <&sa_config>;
		clocks = <&clksa>;
		clock-names = "fck";

		ti,navigator-dmas = <&dma_gbe 26>, <&dma_gbe 6>;
		ti,navigator-dma-names = "crypto-rx", "crypto-tx";

		ti,rx-channel = "crypto-rx";
		ti,rx-queue-depth = <256 64 0 0>;
		ti,rx-compl-queue = <8712>;
		ti,rx-pool	= <512 12>;

		ti,tx-channel = "crypto-tx";
		ti,tx-queue-depth = <256>;
		ti,tx-completion-queue = <8713>;
		ti,tx-pool = <512 12>;
		ti,tx-submit-queue = <646>;

		ti,sc-id = <0x7000 0x71ff>;
	};
};
```

## board/ethan/ethan/Kconfig
```kconfig
if TARGET_AM335X_ETHAN

config SYS_BOARD
	default "ethan"

config SYS_VENDOR
	default "ethan"

config SYS_SOC
	default "am33xx"

config SYS_CONFIG_NAME
	default "am335x_ethan"

config NOR
	bool "Support for NOR flash"
	help
	  The AM335x SoC supports having a NOR flash connected to the GPMC.
	  In practice this is seen as a NOR flash module connected to the
	  "memory cape" for the BeagleBone family.

source "board/ethan/common/Kconfig"

endif
```

## net/hsr-prp/Kconfig
```kconfig
#
# IEC 62439-3 High-availability Seamless Redundancy (HSR) /
# IEC 62439-4 Parallel Redundancy Protocol (PRP) support
#
config HSR_PRP
	tristate "IEC 62439 HSR/PRP Support"
	---help---
	  This enables IEC 62439 defined High-availability Seamless
	  Redundancy (HSR) and Parallel Redundancy Protocol (PRP) support.
	  If you say Y here, then your Linux box will be able to act as a
	  DANH ("Doubly attached node implementing HSR") or DANP ("Doubly
	  attached node implementing PRP"). For this to work, your Linux
	  box needs (at least) two physical Ethernet interfaces.

	  For DANH, it must be connected as a node in a ring network together
	  with other HSR capable nodes. All Ethernet frames sent over the hsr
	  device will be sent in both directions on the ring (over both slave
	  ports), giving a redundant, instant fail-over network. Each HSR node
	  in the ring acts like a bridge for HSR frames, but filters frames
	  that have been forwarded earlier.

	  For DANP, it must be connected as a node connecting to two
	  separate networks over the two slave interfaces. Like HSR, Ethernet
	  frames sent over the prp device will be sent to both networks giving
	  a redundant, instant fail-over network.

	  This code is a "best effort" to comply with the HSR standard as
	  described in IEC 62439-3:2010 (HSRv0) and IEC 62439-3:2012 (HSRv1),
	  and PRP standard described in IEC 62439-4:2012 (PRP), but no
	  compliancy tests have been made. Use iproute2 to select the protocol
	  you would like to use.

	  You need to perform any and all necessary tests yourself before
	  relying on this code in a safety critical system!

	  If unsure, say N.
```
